## reddit_board/Kconfig.reddit_board
```kconfig
# Copyright (c) 2020 Kalyan Sriram
# SPDX-License-Identifier: Apache-2.0

config BOARD_REDDIT_BOARD
	select SOC_STM32F401XE
```

## reddit_board/board.yml
```yaml
board:
  name: reddit_board
  full_name: reddit_board_v1
  vendor: st
  socs:
    - name: stm32f401xe
```
